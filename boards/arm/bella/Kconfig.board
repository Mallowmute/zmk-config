## boards/arm/bella/Kconfig.board
```kconfig
# Copyright (c) 2023 The ZMK Contributors
# SPDX-License-Identifier: MIT

config BOARD_UWU40
    bool "UwU40"
    depends on SOC_NRF52840_QIAA
```

## boards/arm/eclipse/Kconfig
```kconfig
# SPDX-License-Identifier: MIT

config BOARD_ENABLE_DCDC
    bool "Enable DCDC mode"
    select SOC_DCDC_NRF52X
    default y
    depends on BOARD_ECLIPSE

menuconfig ZMK_RGB_UNDERGLOW
    bool "Addressable LED Underglow"
    select LED_STRIP
    select ZMK_LOW_PRIORITY_WORK_QUEUE

if ZMK_RGB_UNDERGLOW

config ZMK_RGB_UNDERGLOW_EXT_POWER
    bool "RGB underglow toggling also controls external power"

config ZMK_RGB_UNDERGLOW_BRT_MAX
    int 75

endif # ZMK_RGB_UNDERGLOW
```

## boards/arm/eclipse/Kconfig.board
```kconfig
# Copyright (c) 2023 The ZMK Contributors
# SPDX-License-Identifier: MIT

config BOARD_ECLIPSE
    bool "Eclipse"
    depends on SOC_NRF52840_QIAA
```

## boards/arm/eclipse/Kconfig.defconfig
```kconfig
# Copyright (c) 2023 The ZMK Contributors
# SPDX-License-Identifier: MIT

if BOARD_ECLIPSE

config ZMK_KEYBOARD_NAME
    default "eclipse"

if USB

config USB_NRFX
    default y

config USB_DEVICE_STACK
    default y

endif # USB

config ZMK_BLE
	default y

config ZMK_USB
	default y

config BT_CTLR
    default BT

config I2C
    default y

config MAX17048
    default y

endif # BOARD_ECLIPSE
```

## boards/shields/disorder11/Kconfig.defconfig
```kconfig
# Copyright (c) 2022 The ZMK Contributors
# SPDX-License-Identifier: MIT

if SHIELD_DISORDER11

config ZMK_KEYBOARD_NAME
    default "disorder11"

endif
```

## boards/shields/disorder11/Kconfig.shield
```kconfig
config SHIELD_DISORDER11
    def_bool $(shields_list_contains,disorder11)
    select GPIO
```

## config/west.yml
```yaml
manifest:
  remotes:
    - name: zmkfirmware
      url-base: https://github.com/zmkfirmware
    - name: ebastler
      url-base: https://github.com/ebastler
    - name: zhiayang
      url-base: https://github.com/zhiayang
  projects:
    - name: zmk
      remote: zmkfirmware
      revision: v0.3
      import: app/west.yml
  self:
    path: config
```
